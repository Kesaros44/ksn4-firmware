## config/boards/shields/ksn_4/Kconfig.defconfig
```kconfig
if SHIELD_KSN_4_LEFT || SHIELD_KSN_4_RIGHT

config ZMK_KEYBOARD_NAME
    default "KSN4"

config ZMK_SPLIT
    default y

endif
```

## config/boards/shields/ksn_4/Kconfig.shield
```kconfig
config SHIELD_KSN_4_LEFT
    def_bool $(shields_list_contains,ksn_4_left)

config SHIELD_KSN_4_RIGHT
    def_bool $(shields_list_contains,ksn_4_right)
```

## config/dts/bindings/behaviors/ksn,behavior-word-flip.yaml
```yaml
description: Retype the last word using the opposite 한/영 language mode
compatible: "ksn,behavior-word-flip"
include: one_param.yaml
```
